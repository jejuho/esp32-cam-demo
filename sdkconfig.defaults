## sdkconfig.defaults
```kconfig
CONFIG_ENABLE_TEST_PATTERN=n
CONFIG_OV2640_SUPPORT=y
CONFIG_OV7725_SUPPORT=y
CONFIG_ESP32_DEFAULT_CPU_FREQ_240=y
CONFIG_ESP32_DEFAULT_CPU_FREQ_MHZ=240
CONFIG_MEMMAP_SMP=y
CONFIG_TASK_WDT=n
CONFIG_FREERTOS_UNICORE=n
CONFIG_FREERTOS_HZ=100
CONFIG_LOG_DEFAULT_LEVEL_INFO=y
CONFIG_LOG_DEFAULT_LEVEL=3
#
# Pin Configuration
#
CONFIG_D0=5
CONFIG_D1=18
CONFIG_D2=19
CONFIG_D3=21
CONFIG_D4=36
CONFIG_D5=39
CONFIG_D6=34
CONFIG_D7=35
CONFIG_XCLK=0
CONFIG_PCLK=22
CONFIG_VSYNC=25
CONFIG_HREF=23
CONFIG_SDA=26
CONFIG_SCL=27
CONFIG_RESET=-1
```
